## meta-iq9-demo/conf/layer.conf
```bitbake
BBPATH .= ":${LAYERDIR}"

BBFILES += "${LAYERDIR}/recipes-*/*/*.bb \
            ${LAYERDIR}/recipes-*/*/*.bbappend"

BBFILE_COLLECTIONS += "meta-iq9-demo"
BBFILE_PATTERN_meta-iq9-demo = "^${LAYERDIR}/"
BBFILE_PRIORITY_meta-iq9-demo = "7"

LAYERDEPENDS_meta-iq9-demo = "core"
LAYERSERIES_COMPAT_meta-iq9-demo = "wrynose"
```
